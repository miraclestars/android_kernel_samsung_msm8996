## arch/arm64/hotplug/Kconfig
```kconfig
menu "Custom Hotplug drivers"

config CUSTOM_HOTPLUG
	bool "Enable custom hotplug support"

config AIO_HOTPLUG
	bool "All in One HotPlug"
	depends on SMP && HOTPLUG_CPU
	default n
	help
	  an All in One HotPlug for Traditional Quad-Core SoCs and 
	  Hexa/Octa-Core big.LITTLE SoCs.

config ALUCARD_HOTPLUG
	bool "Alucard hotplug"
 	default n
 	help
 	  Generic Alucard-hotplug cpu hotplug driver for ARM SOCs.

endmenu
```
